## target/linux/fortisoc/files-6.18/Documentation/devicetree/bindings/arm/fortinet.yaml
```yaml
# SPDX-License-Identifier: (GPL-2.0-only OR BSD-2-Clause)
%YAML 1.2
---
$id: http://devicetree.org/schemas/arm/fortinet.yaml#
$schema: http://devicetree.org/meta-schemas/core.yaml#

title: Fortinet FortiSOC1, FortiSOC2 and FortiSOC3 based boards

maintainers:
  - Radeon24 <Radeon24@users.noreply.github.com>

description: |
  The FortiSOC1 is a Fortinet SoC built around a Faraday FA626TE core and
  stock Faraday peripherals, with a Fortinet network processor. It is
  found in the FortiGate 60C appliance.

  The FortiSOC2 is its successor, built around a Faraday FA726TE core,
  with the NP4Lite network processor. It is found in the FortiGate 60D and
  90D appliances.

  The FortiSOC3 has four Cortex-A9 MPCore cores with a PL310 L2 cache
  controller and the NP6Lite network processor. It is found in the
  FortiGate 60E appliance. Its secondary cores are started through its
  system manager (fortinet,fsoc3-sysmgr): the cpus node of a FortiSOC3
  uses the enable-method "fortinet,fsoc3-smp", under which the operating
  system sets bit 16 + n of the system manager register at offset 0x74,
  then writes the physical address of the entry point of core n, with
  bit 0 set, to the register at offset 0xf0 + 4 * n.

properties:
  $nodename:
    const: /
  compatible:
    oneOf:
      - description: FortiGate 60C
        items:
          - const: fortinet,fg60c
          - const: fortinet,fsoc1
      - description: FortiSOC2 based boards
        items:
          - enum:
              - fortinet,fg60d
              - fortinet,fg90d
          - const: fortinet,fsoc2
      - description: FortiSOC3 based boards
        items:
          - const: fortinet,fg60e
          - const: fortinet,fsoc3

additionalProperties: true
...
```

## target/linux/fortisoc/files-6.18/Documentation/devicetree/bindings/cache/fortinet,fsoc1-l2cc.yaml
```yaml
# SPDX-License-Identifier: (GPL-2.0-only OR BSD-2-Clause)
%YAML 1.2
---
$id: http://devicetree.org/schemas/cache/fortinet,fsoc1-l2cc.yaml#
$schema: http://devicetree.org/meta-schemas/core.yaml#

title: Fortinet FortiSOC1 and FortiSOC2 L2 cache controllers

maintainers:
  - Radeon24 <Radeon24@users.noreply.github.com>

description:
  Outer cache of the Fortinet FortiSOC1 SoC (FortiGate 60C), behind the
  FA626TE core, and of the Fortinet FortiSOC2 SoC (FortiGate 60D), behind
  the FA726TE core. Both are 256 KiB, 8-way, physically addressed caches
  with 32-byte lines, maintained by memory mapped registers. The second
  one is a Faraday FTL2CC031.
  They share the control register and the geometry, but not the auxiliary
  control and maintenance registers, hence the SoC specific compatibles.

allOf:
  - $ref: /schemas/cache-controller.yaml#
  - if:
      properties:
        compatible:
          const: fortinet,fsoc1-l2cc
    then:
      properties:
        fortinet,auxiliary-control: false

properties:
  compatible:
    enum:
      - fortinet,fsoc1-l2cc
      - fortinet,fsoc2-l2cc

  reg:
    maxItems: 1

  cache-level:
    const: 2

  cache-unified: true

  cache-size:
    const: 262144

  cache-sets:
    const: 1024

  cache-line-size:
    const: 32

  fortinet,auxiliary-control:
    $ref: /schemas/types.yaml#/definitions/uint32
    description:
      FortiSOC2 only. Value written to the auxiliary control register
      before the cache is enabled, when the board needs another one than
      the default, 0x00012023 (FortiGate 60D). The FortiGate 90D uses
      0x00012033.

required:
  - compatible
  - reg
  - cache-level
  - cache-unified

unevaluatedProperties: false

examples:
  - |
    cache-controller@e4b00000 {
        compatible = "fortinet,fsoc1-l2cc";
        reg = <0xe4b00000 0x1000>;
        cache-level = <2>;
        cache-unified;
        cache-size = <262144>;
        cache-sets = <1024>;
        cache-line-size = <32>;
    };
  - |
    cache-controller@e4b00000 {
        compatible = "fortinet,fsoc2-l2cc";
        reg = <0xe4b00000 0x1000>;
        cache-level = <2>;
        cache-unified;
        cache-size = <262144>;
        cache-sets = <1024>;
        cache-line-size = <32>;
        fortinet,auxiliary-control = <0x00012033>;
    };
```

## target/linux/fortisoc/files-6.18/Documentation/devicetree/bindings/crypto/fortinet,fsoc1-crypto.yaml
```yaml
# SPDX-License-Identifier: (GPL-2.0-only OR BSD-2-Clause)
%YAML 1.2
---
$id: http://devicetree.org/schemas/crypto/fortinet,fsoc1-crypto.yaml#
$schema: http://devicetree.org/meta-schemas/core.yaml#

title: Fortinet FortiSOC1 and FortiSOC2 crypto engines

maintainers:
  - Radeon24 <Radeon24@users.noreply.github.com>

description:
  Memory to memory crypto engine of the Fortinet FortiSOC1 SoC (FortiGate
  60C), separate from the network processor. It processes a ring of
  descriptors and does DES, 3DES and AES in CBC mode, optionally combined
  with HMAC-MD5 or HMAC-SHA1. The FortiSOC2 (FortiGate 60D) has a second
  generation of the engine, inside the register window of its network
  processor, which also does HMAC-SHA-256/384/512. Its interrupt reaches the
  SoC through the interrupt map of the network processor.

properties:
  compatible:
    enum:
      - fortinet,fsoc1-crypto
      - fortinet,fsoc2-crypto

  reg:
    maxItems: 1

  interrupts:
    maxItems: 1

required:
  - compatible
  - reg
  - interrupts

additionalProperties: false

examples:
  - |
    #include <dt-bindings/interrupt-controller/irq.h>

    crypto@e3e00000 {
        compatible = "fortinet,fsoc1-crypto";
        reg = <0xe3e00000 0x1000>;
        interrupts = <27 IRQ_TYPE_LEVEL_LOW>;
    };

  - |
    #include <dt-bindings/interrupt-controller/irq.h>

    crypto@e3f01900 {
        compatible = "fortinet,fsoc2-crypto";
        reg = <0xe3f01900 0x100>;
        interrupts = <8 IRQ_TYPE_LEVEL_HIGH>;
    };
```

## target/linux/fortisoc/files-6.18/Documentation/devicetree/bindings/crypto/fortinet,fsoc3-cp.yaml
```yaml
# SPDX-License-Identifier: (GPL-2.0-only OR BSD-2-Clause)
%YAML 1.2
---
$id: http://devicetree.org/schemas/crypto/fortinet,fsoc3-cp.yaml#
$schema: http://devicetree.org/meta-schemas/core.yaml#

title: Fortinet FortiSOC3 symmetric crypto engine

maintainers:
  - Radeon24 <Radeon24@users.noreply.github.com>

description:
  Memory to memory cipher and HMAC engine of the Fortinet FortiSOC3, fed
  through a host TX queue of the NP6Lite queue fabric. Its registers lie
  inside the window of the NP6Lite network processor, whose driver requests
  the whole range, so this one only maps them.

properties:
  compatible:
    const: fortinet,fsoc3-cp

  reg:
    items:
      - description: the input queue (host TX queue 16)
      - description: the DMA parameters and control of that queue
      - description: the engine debug registers

required:
  - compatible
  - reg

additionalProperties: false

examples:
  - |
    crypto@f5018000 {
        compatible = "fortinet,fsoc3-cp";
        reg = <0xf5018000 0x400>, <0xf500d860 0x20>, <0xf500e000 0x48>;
    };
```

## target/linux/fortisoc/files-6.18/Documentation/devicetree/bindings/crypto/fortinet,fsoc3-pkce.yaml
```yaml
# SPDX-License-Identifier: (GPL-2.0-only OR BSD-2-Clause)
%YAML 1.2
---
$id: http://devicetree.org/schemas/crypto/fortinet,fsoc3-pkce.yaml#
$schema: http://devicetree.org/meta-schemas/core.yaml#

title: Fortinet FortiSOC3 public key engine

maintainers:
  - Radeon24 <Radeon24@users.noreply.github.com>

description:
  Modular exponentiation engine (RSA) of the Fortinet FortiSOC3. One node
  per command channel; its registers lie inside the window of the NP6Lite
  network processor, whose driver requests the whole range, so this one
  only maps them.

properties:
  compatible:
    const: fortinet,fsoc3-pkce

  reg:
    maxItems: 1

  interrupts:
    maxItems: 1
    description: end of a command list (without it, the driver polls)

required:
  - compatible
  - reg

additionalProperties: false

examples:
  - |
    #include <dt-bindings/interrupt-controller/arm-gic.h>
    #include <dt-bindings/interrupt-controller/irq.h>

    crypto@f501a000 {
        compatible = "fortinet,fsoc3-pkce";
        reg = <0xf501a000 0x80>;
        interrupts = <GIC_SPI 65 IRQ_TYPE_LEVEL_HIGH>;
    };
```

## target/linux/fortisoc/files-6.18/Documentation/devicetree/bindings/gpio/fortinet,fsoc3-gpio.yaml
```yaml
# SPDX-License-Identifier: (GPL-2.0-only OR BSD-2-Clause)
%YAML 1.2
---
$id: http://devicetree.org/schemas/gpio/fortinet,fsoc3-gpio.yaml#
$schema: http://devicetree.org/meta-schemas/core.yaml#

title: Fortinet FortiSOC3 GPIO block

maintainers:
  - Radeon24 <Radeon24@users.noreply.github.com>

description: |
  The 32 GPIO lines of the miscellaneous block of the NP6Lite network
  processor of the Fortinet FortiSOC3 (fortinet,fsoc3-np6lite), at offset
  0xfc00 of its register window. The registers are 8 bytes apart: input
  level (0x00), output latch (0x08), direction, 1 for an output (0x10),
  interrupt mask (0x30) and status (0x38), output clear (0x48) and
  direction clear (0x50).

  The output, direction and their clear registers set or clear the bits
  written as 1 only. The block lies inside the register window of the
  network processor, whose driver drives some of its lines itself (MDC
  lines, PHY and switch resets): such lines are listed in
  gpio-reserved-ranges. No interrupt line of the block is known.

properties:
  compatible:
    const: fortinet,fsoc3-gpio

  reg:
    maxItems: 1

  gpio-controller: true

  "#gpio-cells":
    const: 2

  ngpios:
    const: 32

  gpio-reserved-ranges: true

  gpio-line-names:
    maxItems: 32

patternProperties:
  "-hog(-[0-9]+)?$":
    type: object
    required:
      - gpio-hog

required:
  - compatible
  - reg
  - gpio-controller
  - "#gpio-cells"

additionalProperties: false

examples:
  - |
    gpio@f500fc00 {
        compatible = "fortinet,fsoc3-gpio";
        reg = <0xf500fc00 0x80>;
        gpio-controller;
        #gpio-cells = <2>;
        ngpios = <32>;
        gpio-reserved-ranges = <17 2>, <20 6>;
    };
```

## target/linux/fortisoc/files-6.18/Documentation/devicetree/bindings/gpio/fortinet,fsoc3-sysmgr-gpio.yaml
```yaml
# SPDX-License-Identifier: (GPL-2.0-only OR BSD-2-Clause)
%YAML 1.2
---
$id: http://devicetree.org/schemas/gpio/fortinet,fsoc3-sysmgr-gpio.yaml#
$schema: http://devicetree.org/meta-schemas/core.yaml#

title: Fortinet FortiSOC3 system manager output lines

maintainers:
  - Radeon24 <Radeon24@users.noreply.github.com>

description: |
  Output lines of the system manager of the Fortinet FortiSOC3
  (fortinet,fsoc3-sysmgr): line n is bit n of three of its registers,
  pin function (0xc0, 1 = general purpose line), output level (0xc8) and
  output enable (0xd0). The lines are output only. On the FortiGate 60E,
  lines 23 and 19 are the second terminal of the bicolour speed LED of
  the wan1 and wan2 ports, whose first terminal is the LED[0] pin of the
  port PHY: the LED is orange when the line is low and LED[0] is not
  lit. The lines a board does not use are listed in gpio-reserved-ranges
  and never written.

properties:
  compatible:
    const: fortinet,fsoc3-sysmgr-gpio

  fortinet,sysmgr:
    $ref: /schemas/types.yaml#/definitions/phandle
    description: The system manager (fortinet,fsoc3-sysmgr) node.

  gpio-controller: true

  "#gpio-cells":
    const: 2

  ngpios:
    const: 32

  gpio-reserved-ranges: true

required:
  - compatible
  - fortinet,sysmgr
  - gpio-controller
  - "#gpio-cells"

additionalProperties: false

examples:
  - |
    gpio {
        compatible = "fortinet,fsoc3-sysmgr-gpio";
        fortinet,sysmgr = <&sysmgr>;
        gpio-controller;
        #gpio-cells = <2>;
        ngpios = <32>;
        gpio-reserved-ranges = <0 19>, <20 3>, <24 8>;
    };
```

## target/linux/fortisoc/files-6.18/Documentation/devicetree/bindings/i2c/fortinet,fsoc3-i2c.yaml
```yaml
# SPDX-License-Identifier: (GPL-2.0-only OR BSD-2-Clause)
%YAML 1.2
---
$id: http://devicetree.org/schemas/i2c/fortinet,fsoc3-i2c.yaml#
$schema: http://devicetree.org/meta-schemas/core.yaml#

title: Fortinet FortiSOC3 I2C controller

maintainers:
  - Radeon24 <Radeon24@users.noreply.github.com>

description:
  The Fortinet FortiSOC3 has two I2C controllers of the NEC/Renesas IICA
  family. Their control bits are those of the IICA, but the register map
  differs from the one of renesas,iic-emev2 (split control register, 16-bit
  status register, no separate enable register). Each has two edge
  triggered interrupts, one at the end of each byte transferred and one on
  a stop condition.

allOf:
  - $ref: /schemas/i2c/i2c-controller.yaml#

properties:
  compatible:
    const: fortinet,fsoc3-i2c

  reg:
    maxItems: 1

  interrupts:
    items:
      - description: Transfer (end of a byte)
      - description: Stop condition detected

  interrupt-names:
    items:
      - const: transfer
      - const: stop

  clocks:
    maxItems: 1
    description:
      Input clock of the controller. Optional, the SCL widths being set
      for the rate the controller runs at on the FortiSOC3.

required:
  - compatible
  - reg
  - interrupts

unevaluatedProperties: false

examples:
  - |
    #include <dt-bindings/interrupt-controller/arm-gic.h>
    #include <dt-bindings/interrupt-controller/irq.h>

    i2c@fb004000 {
        compatible = "fortinet,fsoc3-i2c";
        reg = <0xfb004000 0x1000>;
        interrupts = <GIC_SPI 13 IRQ_TYPE_EDGE_RISING>,
                     <GIC_SPI 12 IRQ_TYPE_EDGE_RISING>;
        interrupt-names = "transfer", "stop";
        #address-cells = <1>;
        #size-cells = <0>;

        rtc@51 {
            compatible = "nxp,pcf8563";
            reg = <0x51>;
        };
    };
```
