## target/linux/fortisoc/files-6.18/Documentation/devicetree/bindings/net/fortinet,fsoc1-np.yaml
```yaml
# SPDX-License-Identifier: (GPL-2.0-only OR BSD-2-Clause)
%YAML 1.2
---
$id: http://devicetree.org/schemas/net/fortinet,fsoc1-np.yaml#
$schema: http://devicetree.org/meta-schemas/core.yaml#

title: Fortinet FortiSOC1 and FortiSOC2 network processors

maintainers:
  - Radeon24 <Radeon24@users.noreply.github.com>

description: |
  The network processor (NP) of the Fortinet FortiSOC1 has four RGMII
  capable Ethernet ports and exchanges frames with the host through a
  single pair of DMA descriptor rings (the host interface). It also
  contains the MDIO controller the external PHYs and switch are attached
  to.

  The NP of the FortiSOC2 (NP4Lite) keeps the same layout, with a second
  register block that routes its interrupt sources to the SoC interrupt
  controller. It sits in the second 4 KiB page of the NP window, the rest
  of which belongs to other blocks.

  The NP needs a packet buffer of its own in system memory, outside of
  the memory used by the operating system. Its flow engine, which forwards
  known flows between the ports without the host, keeps its tables in
  system memory too, as well as its command and message queues.

properties:
  compatible:
    enum:
      - fortinet,fsoc1-np
      - fortinet,fsoc2-np

  reg:
    minItems: 1
    items:
      - description: NP registers, the first 4 KiB page of its window
      - description:
          Interrupt routing (FortiSOC2 only), 256 bytes at 0x1e00 into the
          NP window

  reg-names:
    minItems: 1
    items:
      - const: np
      - const: irq-map

  interrupts:
    maxItems: 1

  memory-region:
    minItems: 1
    items:
      - description:
          Private packet buffer of the NP, 8 MiB (FortiSOC1) or 16 MiB
          (FortiSOC2), aligned on 64 KiB.
      - description:
          Memory the boot loader leaves the NP DMA engine working in (its
          descriptor rings and buffers). It must stay untouched until the
          driver has taken the host interface over.
      - description:
          Flow tables of the NP flow engine, 56 MiB aligned on 4 MiB and
          below 1 GiB, outside of the memory used by the operating system.
          Without it, the NP does not offload flows.
      - description:
          FortiSOC1, command ring and message queue of the NP flow engine,
          160 KiB at least, aligned on 4 KiB and below 4 GiB, outside of
          the memory used by the operating system. Needed for flow offload
          too; the FortiSOC2 engine has neither. FortiSOC2, security
          association area of the NP IPsec engine, 4 MiB outside of the
          memory used by the operating system.

  nvmem-cells:
    maxItems: 1
    description:
      Base MAC address of the ports, a "mac-base" cell (port n gets the
      base + n). Without it, the base is taken from the logical interface
      table the boot loader leaves.

  nvmem-cell-names:
    const: mac-base

  post-init-providers:
    description:
      The node of the "mac-base" cell, which never becomes a device. The
      driver waits for the cell until the end of the boot, then falls back
      to the logical interface table, instead of a probe held forever.

  fortinet,reset-pins:
    $ref: /schemas/types.yaml#/definitions/uint32-array
    description:
      GPIO pins of the NP holding a PHY or the switch in reset when low.
      The driver pulses them low, then leaves them outputs at 1, before the
      MDIO bus is registered.
    items:
      maximum: 31

  mdio:
    $ref: /schemas/net/mdio.yaml#
    unevaluatedProperties: false

  ethernet-ports:
    type: object
    additionalProperties: false

    properties:
      "#address-cells":
        const: 1

      "#size-cells":
        const: 0

    patternProperties:
      "^ethernet-port@[0-3]$":
        type: object
        $ref: ethernet-controller.yaml#
        unevaluatedProperties: false
        description: One Ethernet port of the NP.

        properties:
          reg:
            maximum: 3
            description:
              Port number, the link of the NP the port is wired to, which is
              also the register bank.

          fortinet,logical-interface:
            $ref: /schemas/types.yaml#/definitions/uint32
            maximum: 19
            description:
              Logical interface (LIF), the index the NP classes the frames
              received on the link to, and that the frames sent through the
              port target. Defaults to the port number; set on boards whose
              wiring numbers them apart (wan1 and wan2 on links 0 and 1 but
              LIFs 2 and 3, for instance). Each port has a LIF of its own.
              The LIFs of the ports stay below the traffic counters of the
              flows, 8 at most, 19 when switch ports take LIFs of their own
              (fortinet,switch-logical-interfaces); a port of a bond needs a
              LIF below the number of ports when no switch port takes one.
              On a DSA conduit with fortinet,switch-logical-interfaces, the
              LIF of the frames of the switch that the NP does not class by
              switch port.

          fortinet,switch-logical-interfaces:
            $ref: /schemas/types.yaml#/definitions/uint32-array
            minItems: 8
            maxItems: 8
            items:
              maximum: 19
            description:
              DSA conduit to a Broadcom switch (BCM53128, ports 0 to 7, the
              CPU port 8), with the Broadcom tag. The LIF of each switch
              port, by port number, 0 for none, for a network processor
              that classes the frames of the switch by source port (the
              FortiSOC2 does, given a LIF per port). Each LIF used once on
              the NP, apart from the LIF of every port. The conduit may be
              the only one of its NP, or one of several (one per link).
              Without it, the frames of every switch port stay on the LIF
              of the conduit.

          post-init-providers: true

        required:
          - reg
          - phy-mode

    required:
      - "#address-cells"
      - "#size-cells"

required:
  - compatible
  - reg
  - interrupts
  - memory-region
  - ethernet-ports

allOf:
  - if:
      properties:
        compatible:
          contains:
            const: fortinet,fsoc2-np
    then:
      properties:
        reg:
          minItems: 2
        reg-names:
          minItems: 2
        memory-region:
          maxItems: 4
      required:
        - reg-names
    else:
      properties:
        reg:
          maxItems: 1
        reg-names:
          maxItems: 1

additionalProperties: false

examples:
  - |
    #include <dt-bindings/interrupt-controller/irq.h>

    ethernet@e3f00000 {
        compatible = "fortinet,fsoc1-np";
        reg = <0xe3f00000 0x1000>;
        interrupts = <26 IRQ_TYPE_LEVEL_HIGH>;
        memory-region = <&np_pbuf>, <&np_loader>, <&np_flow>,
                        <&np_queues>;

        mdio {
            #address-cells = <1>;
            #size-cells = <0>;

            phy3: ethernet-phy@3 {
                reg = <3>;
            };
        };

        ethernet-ports {
            #address-cells = <1>;
            #size-cells = <0>;

            ethernet-port@0 {
                reg = <0>;
                phy-mode = "rgmii-id";

                fixed-link {
                    speed = <1000>;
                    full-duplex;
                };
            };

            ethernet-port@1 {
                reg = <1>;
                label = "wan1";
                phy-handle = <&phy3>;
                phy-mode = "rgmii-id";
            };
        };
    };

  - |
    #include <dt-bindings/interrupt-controller/irq.h>

    ethernet@e3f00000 {
        compatible = "fortinet,fsoc2-np";
        reg = <0xe3f00000 0x1000>, <0xe3f01e00 0x100>;
        reg-names = "np", "irq-map";
        interrupts = <20 IRQ_TYPE_LEVEL_HIGH>;
        memory-region = <&np_pbuf>, <&np_loader>, <&np_flow>, <&np_sa>;

        mdio {
            #address-cells = <1>;
            #size-cells = <0>;

            phy24: ethernet-phy@18 {
                reg = <0x18>;
            };
        };

        ethernet-ports {
            #address-cells = <1>;
            #size-cells = <0>;

            ethernet-port@2 {
                reg = <2>;
                label = "wan1";
                phy-handle = <&phy24>;
                phy-mode = "rgmii-id";
            };
        };
    };
```

## target/linux/fortisoc/files-6.18/Documentation/devicetree/bindings/net/fortinet,fsoc3-np6lite.yaml
```yaml
# SPDX-License-Identifier: (GPL-2.0-only OR BSD-2-Clause)
%YAML 1.2
---
$id: http://devicetree.org/schemas/net/fortinet,fsoc3-np6lite.yaml#
$schema: http://devicetree.org/meta-schemas/core.yaml#

title: Fortinet FortiSOC3 NP6Lite network processor

maintainers:
  - Radeon24 <Radeon24@users.noreply.github.com>

description: |
  The NP6Lite network processor of the Fortinet FortiSOC3 has ten Ethernet
  links (MACs), SGMII or RGMII, and exchanges frames with the host through
  sixteen pairs of DMA descriptor queues, a 10-byte tag in front of each
  frame naming its logical interface (LIF). Its interrupt sources are
  grouped into four host interface vectors and one error vector, each
  signalled as a pulse. Its miscellaneous block holds two MDIO masters
  sharing one MDIO line, whose clock is one of the GPIO lines of the block
  (see fortinet,fsoc3-gpio), and the GPIO lines holding the PHYs and the
  switch in reset.

  The network processor reaches the host memory through the accelerator
  coherency port of the SoC (see fortinet,fsoc3-acp).

  The boot loader leaves its traffic counter engine enabled, with its
  counters at physical address 0: fortinet,tce-base moves them away from
  the memory of the operating system.

properties:
  compatible:
    const: fortinet,fsoc3-np6lite

  reg:
    maxItems: 1

  interrupts:
    items:
      - description: Host interface vector 0
      - description: Host interface vector 1
      - description: Host interface vector 2
      - description: Host interface vector 3
      - description: Errors of the host queues

  interrupt-names:
    items:
      - const: hif0
      - const: hif1
      - const: hif2
      - const: hif3
      - const: err

  dma-coherent: true

  fortinet,reset-pins:
    $ref: /schemas/types.yaml#/definitions/uint32-array
    description:
      GPIO lines of the network processor holding a PHY or the switch in
      reset when low. They are pulsed low, then left outputs at 1, before
      the MDIO buses are registered.
    items:
      maximum: 31

  fortinet,init-logical-interfaces:
    type: boolean
    description:
      The logical interface tables of the network processor (LIF to link,
      host queue and MTU) are to be programmed by the operating system for
      every port, the boot loader leaving them set for its own interfaces
      only.

  fortinet,tce-base:
    $ref: /schemas/types.yaml#/definitions/uint32
    description:
      Physical address of the counters of the traffic counter engine
      (0x8000 counters of 16 bytes, 512 KiB at most), outside of the memory
      of the operating system. Without it, the counter base is left as the
      boot loader set it.

  ethernet-ports:
    type: object
    additionalProperties: false

    properties:
      "#address-cells":
        const: 1

      "#size-cells":
        const: 0

    patternProperties:
      "^(ethernet-)?port@[0-9a-f]+$":
        type: object
        $ref: ethernet-controller.yaml#
        unevaluatedProperties: false
        description:
          One network interface of the host on the network processor.

        properties:
          reg:
            enum: [0, 2, 3, 4, 5, 6, 7, 8, 9, 10, 11, 12, 13, 14, 15]
            description:
              Logical interface (LIF) of the port, which names its frames
              between the host and the network processor. LIF 1 belongs to
              the host.

          fortinet,np-link:
            $ref: /schemas/types.yaml#/definitions/uint32
            minimum: 1
            maximum: 10
            description:
              Link of the network processor the port is wired to, its MAC
              number plus one.

          fortinet,switch-logical-interfaces:
            $ref: /schemas/types.yaml#/definitions/uint32-array
            minItems: 1
            maxItems: 8
            items:
              - const: 0
            additionalItems:
              enum: [0, 2, 3, 4, 5, 6, 7, 8, 9, 10, 11, 12, 13, 14, 15]
            description:
              DSA conduit to a Broadcom switch (BCM53128, ports 0 to 7), with
              the Broadcom tag. The LIF of each switch port, by port number,
              0 for none, for the network processor to class the frames of
              the switch by source port; ports past the end of the list have
              none. Switch port 0 is classed like the conduit itself, so the
              first value is always 0. Each LIF used once, and none the LIF
              of a port. Without it, the frames of every switch port stay on
              the LIF of the conduit.

          post-init-providers: true

        required:
          - reg
          - fortinet,np-link

    required:
      - "#address-cells"
      - "#size-cells"

patternProperties:
  "^mdio(-switch)?$":
    $ref: /schemas/net/mdio.yaml#
    unevaluatedProperties: false
    description:
      MDIO buses of the network processor, "mdio" for the PHYs of the
      links, "mdio-switch" for the switch.

    properties:
      fortinet,mdc-pin:
        $ref: /schemas/types.yaml#/definitions/uint32
        maximum: 31
        description:
          GPIO line of the network processor carrying the clock (MDC) of
          this bus. Without it, the bus clock is left as the boot loader
          set it.

required:
  - compatible
  - reg
  - interrupts
  - ethernet-ports

additionalProperties: false

examples:
  - |
    #include <dt-bindings/interrupt-controller/arm-gic.h>
    #include <dt-bindings/interrupt-controller/irq.h>

    ethernet@f5000000 {
        compatible = "fortinet,fsoc3-np6lite";
        reg = <0xf5000000 0x20000>;
        interrupts = <GIC_SPI 48 IRQ_TYPE_EDGE_RISING>,
                     <GIC_SPI 49 IRQ_TYPE_EDGE_RISING>,
                     <GIC_SPI 50 IRQ_TYPE_EDGE_RISING>,
                     <GIC_SPI 51 IRQ_TYPE_EDGE_RISING>,
                     <GIC_SPI 52 IRQ_TYPE_EDGE_RISING>;
        interrupt-names = "hif0", "hif1", "hif2", "hif3", "err";
        dma-coherent;
        fortinet,reset-pins = <20 22 24>;
        fortinet,init-logical-interfaces;
        fortinet,tce-base = <0x76000000>;

        mdio {
            #address-cells = <1>;
            #size-cells = <0>;
            fortinet,mdc-pin = <17>;

            phy0: ethernet-phy@0 {
                reg = <0>;
            };
        };

        mdio-switch {
            #address-cells = <1>;
            #size-cells = <0>;
            fortinet,mdc-pin = <18>;
        };

        ethernet-ports {
            #address-cells = <1>;
            #size-cells = <0>;

            port@0 {
                reg = <0>;
                label = "wan1";
                fortinet,np-link = <3>;
                phy-handle = <&phy0>;
                phy-mode = "sgmii";
            };

            port@3 {
                reg = <3>;
                fortinet,np-link = <1>;
                phy-mode = "rgmii";

                fixed-link {
                    speed = <1000>;
                    full-duplex;
                };
            };
        };
    };
```
