## target/linux/fortisoc/files-6.18/Documentation/devicetree/bindings/misc/fortinet,disk-rootfs-data.yaml
```yaml
# SPDX-License-Identifier: (GPL-2.0-only OR BSD-2-Clause)
%YAML 1.2
---
$id: http://devicetree.org/schemas/misc/fortinet,disk-rootfs-data.yaml#
$schema: http://devicetree.org/meta-schemas/core.yaml#

title: Writable data area of a firmware slot on an internal boot disk

maintainers:
  - Radeon24 <Radeon24@users.noreply.github.com>

description: |
  Some appliances boot from an internal disk holding firmware slots behind
  a boot sector. The slot of the running system holds the boot image
  followed by an area reserved for a writable file system (rootfs_data).
  This node describes that area for user space: the disk is the one block
  device of the given size, and of the given vendor and model when they are
  present; the area is given in absolute 512-byte sectors of that disk.

  The node is not a device: no kernel driver binds to it. It is a direct
  child of the root node, found by its compatible.

properties:
  compatible:
    const: fortinet,disk-rootfs-data

  fortinet,disk-vendor:
    $ref: /schemas/types.yaml#/definitions/string
    pattern: "^.{1,8}$"
    description:
      Vendor identification of the disk, as its SCSI INQUIRY data gives it,
      without the trailing spaces. Without it, the vendor is not checked.

  fortinet,disk-model:
    $ref: /schemas/types.yaml#/definitions/string
    pattern: "^.{1,16}$"
    description:
      Product identification of the disk, as its SCSI INQUIRY data gives
      it, without the trailing spaces. Without it, the model is not
      checked.

  fortinet,disk-sectors:
    $ref: /schemas/types.yaml#/definitions/uint64
    minimum: 1
    description:
      Exact size of the disk, in 512-byte sectors.

  fortinet,rootfs-data:
    $ref: /schemas/types.yaml#/definitions/uint32-matrix
    maxItems: 1
    items:
      items:
        - description: First 512-byte sector of the area, on the whole disk
          minimum: 1
        - description: Number of sectors of the area
          minimum: 1
    description:
      Area of the disk that holds the writable file system of the running
      system. It is reached through a loop device backed by the whole disk,
      whose page cache writes back whole 4 KiB pages: start and count are
      multiples of 8 sectors.

required:
  - compatible
  - fortinet,disk-sectors
  - fortinet,rootfs-data

additionalProperties: false

examples:
  - |
    rootfs-data {
        compatible = "fortinet,disk-rootfs-data";
        fortinet,disk-vendor = "VENDOR";
        fortinet,disk-model = "BOOT_DISK";
        fortinet,disk-sectors = /bits/ 64 <7913472>;
        fortinet,rootfs-data = <32768 491520>;
    };
```

## target/linux/fortisoc/files-6.18/Documentation/devicetree/bindings/misc/fortinet,usb-disk-write-windows.yaml
```yaml
# SPDX-License-Identifier: (GPL-2.0-only OR BSD-2-Clause)
%YAML 1.2
---
$id: http://devicetree.org/schemas/misc/fortinet,usb-disk-write-windows.yaml#
$schema: http://devicetree.org/meta-schemas/core.yaml#

title: Write windows of an internal dual-slot USB boot disk

maintainers:
  - Radeon24 <Radeon24@users.noreply.github.com>

description: |
  Some appliances boot from an internal USB mass storage disk holding two
  firmware slots and a data partition, behind a boot sector that names the
  image of each slot. This node describes that disk and the parts of it an
  installer running on the appliance may write, so that the operating
  system can guard the disk: every write is refused, except plain writes
  lying entirely inside one of the windows while they are armed from user
  space. A write starting at sector 0 may only change the listed bytes of
  that sector. Persistent windows, if any, are open without arming, from
  the time the disk is found until user space turns the windows off, for a
  file system kept on that part of the disk.

  The node is not a device. The disk is the one USB mass storage disk whose
  SCSI vendor and model match; without the node, no disk is guarded.

properties:
  compatible:
    const: fortinet,usb-disk-write-windows

  fortinet,disk-vendor:
    $ref: /schemas/types.yaml#/definitions/string
    pattern: "^.{1,8}$"
    description:
      Vendor identification of the disk, as its SCSI INQUIRY data gives it,
      without the trailing spaces.

  fortinet,disk-model:
    $ref: /schemas/types.yaml#/definitions/string
    pattern: "^.{1,16}$"
    description:
      Product identification of the disk, as its SCSI INQUIRY data gives
      it, without the trailing spaces.

  fortinet,disk-sectors:
    $ref: /schemas/types.yaml#/definitions/uint64
    minimum: 1
    description:
      Exact size of the disk, in 512-byte sectors. A disk of another size
      matching the vendor and model is guarded with no window. Without it,
      the size is not checked.

  fortinet,write-windows:
    $ref: /schemas/types.yaml#/definitions/uint32-matrix
    maxItems: 4
    items:
      items:
        - description: First 512-byte sector of the window, on the whole disk
        - description: Number of sectors of the window
          minimum: 1
    description:
      Parts of the disk an installer may write once the windows are armed.
      Without it, every write to the disk is refused.

  fortinet,persistent-windows:
    $ref: /schemas/types.yaml#/definitions/uint32-matrix
    maxItems: 4
    items:
      items:
        - description: First 512-byte sector of the window, on the whole
            disk, never sector 0
          minimum: 1
        - description: Number of sectors of the window
          minimum: 1
    description:
      Parts of the disk any plain write may change without arming, until
      the windows are turned off; the end of an armed time leaves them
      open. A window over sector 0 is a bad configuration (every write
      refused). Without it, no part of the disk is writable unarmed. A
      window written through the page cache of the whole disk starts and
      ends on its 4 KiB pages (multiples of 8 sectors), or the write back
      of a page across its edge is refused.

  fortinet,sector0-bytes:
    $ref: /schemas/types.yaml#/definitions/uint32-matrix
    maxItems: 8
    items:
      items:
        - description: Offset of the bytes in sector 0
          maximum: 511
        - description: Number of bytes
          minimum: 1
          maximum: 512
    description:
      Bytes of sector 0 a write to a window starting at sector 0 may
      change, compared with the content of the sector when the windows are
      armed. Without it, such a write may not change sector 0 at all.

required:
  - compatible
  - fortinet,disk-vendor
  - fortinet,disk-model

additionalProperties: false

examples:
  - |
    write-windows {
        compatible = "fortinet,usb-disk-write-windows";
        fortinet,disk-vendor = "VENDOR";
        fortinet,disk-model = "BOOT_DISK";
        fortinet,disk-sectors = /bits/ 64 <7913472>;
        fortinet,write-windows = <0 1>, <1 524288>;
        fortinet,sector0-bytes = <0x10 32>, <0x128 4>;
        fortinet,persistent-windows = <32768 491520>;
    };
```

## target/linux/fortisoc/files-6.18/Documentation/devicetree/bindings/mmc/fortinet,fsoc3-sdhi.yaml
```yaml
# SPDX-License-Identifier: (GPL-2.0-only OR BSD-2-Clause)
%YAML 1.2
---
$id: http://devicetree.org/schemas/mmc/fortinet,fsoc3-sdhi.yaml#
$schema: http://devicetree.org/meta-schemas/core.yaml#

title: Fortinet FortiSOC3 SD/MMC host interface

maintainers:
  - Radeon24 <Radeon24@users.noreply.github.com>

description:
  The eMMC controller of the Fortinet FortiSOC3, a Renesas R-Car Gen3 style
  SDHI (TMIO family) with its registers 8 bytes apart and a 32-bit data
  port. Its internal DMA controller, at offset 0x800, is not described.

allOf:
  - $ref: mmc-controller.yaml#

properties:
  compatible:
    const: fortinet,fsoc3-sdhi

  reg:
    maxItems: 1

  interrupts:
    maxItems: 1

  clocks:
    maxItems: 1
    description:
      Input clock of the controller, from which the card clock is divided.

  resets:
    maxItems: 1

  fortinet,force-ro:
    type: boolean
    description:
      Only pass to the controller the commands needed to bring a card up
      and to read its user area. Writes, erases, write protection, locking
      and changes of the extended CSD registers other than the bus width
      and the timing are refused before they reach the card, whoever
      issues them.

  fortinet,write-windows:
    $ref: /schemas/types.yaml#/definitions/uint32-matrix
    maxItems: 4
    items:
      items:
        - description: First 512-byte sector of the window, in the user area
        - description: Number of sectors of the window
          minimum: 1
    description:
      Write windows of the read-only guard, for an installer writing one
      firmware slot. Once armed from user space, plain writes of 512-byte
      blocks to the user area lying entirely inside one window are let
      through; everything else stays refused. In a write of sector 0,
      only the bytes listed by fortinet,sector0-bytes may change. Without
      windows, the guard refuses every write.

  fortinet,sector0-bytes:
    $ref: /schemas/types.yaml#/definitions/uint32-matrix
    maxItems: 8
    items:
      items:
        - description: Offset of the first byte, in sector 0
          maximum: 511
        - description: Number of bytes
          minimum: 1
          maximum: 512
    description:
      Bytes of sector 0 that a write through a window may change, compared
      with sector 0 as it was when the windows were armed. Without it, the
      content of sector 0 may not change at all.

  fortinet,persistent-windows:
    $ref: /schemas/types.yaml#/definitions/uint32-matrix
    maxItems: 4
    items:
      items:
        - description: First 512-byte sector of the window, in the user
            area, never sector 0
          minimum: 1
        - description: Number of sectors of the window
          minimum: 1
    description:
      Areas of the user area holding a writable file system, open to plain
      writes of 512-byte blocks from boot, without arming, until the
      windows are turned off. An area reached through a loop device backed
      by the whole disk is aligned on 4 KiB pages (multiples of 8 sectors).

dependencies:
  fortinet,write-windows: [ "fortinet,force-ro" ]
  fortinet,sector0-bytes: [ "fortinet,write-windows" ]
  fortinet,persistent-windows: [ "fortinet,force-ro" ]

required:
  - compatible
  - reg
  - interrupts
  - clocks

unevaluatedProperties: false

examples:
  - |
    #include <dt-bindings/interrupt-controller/arm-gic.h>
    #include <dt-bindings/interrupt-controller/irq.h>

    mmc@f3010000 {
        compatible = "fortinet,fsoc3-sdhi";
        reg = <0xf3010000 0x2000>;
        interrupts = <GIC_SPI 22 IRQ_TYPE_LEVEL_HIGH>;
        clocks = <&sdhi_clk>;
        bus-width = <4>;
        max-frequency = <25000000>;
        non-removable;
        no-sdio;
        no-sd;
        fortinet,force-ro;
        fortinet,write-windows = <0 1>, <786440 524288>;
        fortinet,sector0-bytes = <0x30 32>, <0x12c 4>, <0x1be 1>, <0x1ce 1>;
        fortinet,persistent-windows = <819208 491520>;
    };
```
