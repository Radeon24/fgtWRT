## target/linux/fortisoc/files-6.18/Documentation/devicetree/bindings/nvmem/fortinet,fsoc3-boot-flash.yaml
```yaml
# SPDX-License-Identifier: (GPL-2.0-only OR BSD-2-Clause)
%YAML 1.2
---
$id: http://devicetree.org/schemas/nvmem/fortinet,fsoc3-boot-flash.yaml#
$schema: http://devicetree.org/meta-schemas/core.yaml#

title: Fortinet FortiSOC3 boot flash factory block

maintainers:
  - Radeon24 <Radeon24@users.noreply.github.com>

description:
  The Fortinet FortiSOC3 reaches the SPI NOR flash holding its boot loader
  and factory data through a small command port, which sends and receives
  one byte at a time. The factory block, 32 KiB at offset 0x1f8000 of the
  flash, is exposed as a read-only NVMEM device whose offsets are relative
  to the start of that block. On the FortiGate 60E, the base MAC address
  of the appliance is the 6 bytes at offset 0x5880 of the block, the port
  of rank n getting the base + n; a "mac-base" cell gives it.

allOf:
  - $ref: nvmem.yaml#

properties:
  compatible:
    const: fortinet,fsoc3-boot-flash

  reg:
    maxItems: 1

required:
  - compatible
  - reg

unevaluatedProperties: false

examples:
  - |
    flash-controller@fd300000 {
        compatible = "fortinet,fsoc3-boot-flash";
        reg = <0xfd300000 0x1000>;

        nvmem-layout {
            compatible = "fixed-layout";
            #address-cells = <1>;
            #size-cells = <1>;

            mac-address@5880 {
                compatible = "mac-base";
                reg = <0x5880 0x6>;
                #nvmem-cell-cells = <1>;
            };
        };
    };
```

## target/linux/fortisoc/files-6.18/Documentation/devicetree/bindings/pci/fortinet,fsoc3-pcie.yaml
```yaml
# SPDX-License-Identifier: (GPL-2.0-only OR BSD-2-Clause)
%YAML 1.2
---
$id: http://devicetree.org/schemas/pci/fortinet,fsoc3-pcie.yaml#
$schema: http://devicetree.org/meta-schemas/core.yaml#

title: Fortinet FortiSOC3 PCIe root port

description: |
  The single PCIe root port of the Fortinet FortiSOC3, behind a small
  register block of the SoC through which the link state is read and the
  configuration accesses are made. The memory window of the link is fixed
  (16 MiB at 0xf0000000 on the FortiGate 100E). No MSI: the legacy
  interrupts come on one interrupt of the GIC.

maintainers:
  - Radeon24 <Radeon24@users.noreply.github.com>

allOf:
  - $ref: /schemas/pci/pci-host-bridge.yaml#

properties:
  compatible:
    const: fortinet,fsoc3-pcie

  reg:
    maxItems: 1

  ranges:
    maxItems: 1

  interrupt-map: true

  interrupt-map-mask: true

  "#interrupt-cells":
    const: 1

required:
  - compatible
  - reg
  - ranges
  - interrupt-map
  - interrupt-map-mask
  - "#interrupt-cells"

unevaluatedProperties: false

examples:
  - |
    #include <dt-bindings/interrupt-controller/arm-gic.h>

    pcie@f3000000 {
        compatible = "fortinet,fsoc3-pcie";
        reg = <0xf3000000 0x100>;
        device_type = "pci";
        #address-cells = <3>;
        #size-cells = <2>;
        #interrupt-cells = <1>;
        bus-range = <0x00 0x01>;
        ranges = <0x02000000 0 0xf0000000 0xf0000000 0 0x01000000>;
        interrupt-map-mask = <0 0 0 7>;
        interrupt-map = <0 0 0 1 &gic GIC_SPI 112 IRQ_TYPE_LEVEL_HIGH>,
                        <0 0 0 2 &gic GIC_SPI 112 IRQ_TYPE_LEVEL_HIGH>,
                        <0 0 0 3 &gic GIC_SPI 112 IRQ_TYPE_LEVEL_HIGH>,
                        <0 0 0 4 &gic GIC_SPI 112 IRQ_TYPE_LEVEL_HIGH>;
    };
```

## target/linux/fortisoc/files-6.18/Documentation/devicetree/bindings/power/reset/fortinet,fsoc3-reboot.yaml
```yaml
# SPDX-License-Identifier: (GPL-2.0-only OR BSD-2-Clause)
%YAML 1.2
---
$id: http://devicetree.org/schemas/power/reset/fortinet,fsoc3-reboot.yaml#
$schema: http://devicetree.org/meta-schemas/core.yaml#

title: Fortinet FortiSOC3 restart

maintainers:
  - Radeon24 <Radeon24@users.noreply.github.com>

description:
  The Fortinet FortiSOC3 restarts on a rising edge of bit 1 of the system
  manager register at offset 0x68. The bit is first written low, then
  high, the other bits of the register being written back unchanged. A
  single masked write, as syscon-reboot does, would not produce the edge
  when the bit is already set.

properties:
  compatible:
    const: fortinet,fsoc3-reboot

  fortinet,sysmgr:
    $ref: /schemas/types.yaml#/definitions/phandle
    description: The system manager (fortinet,fsoc3-sysmgr) node.

required:
  - compatible
  - fortinet,sysmgr

additionalProperties: false

examples:
  - |
    reboot {
        compatible = "fortinet,fsoc3-reboot";
        fortinet,sysmgr = <&sysmgr>;
    };
```

## target/linux/fortisoc/files-6.18/Documentation/devicetree/bindings/rng/fortinet,fsoc3-trng.yaml
```yaml
# SPDX-License-Identifier: (GPL-2.0-only OR BSD-2-Clause)
%YAML 1.2
---
$id: http://devicetree.org/schemas/rng/fortinet,fsoc3-trng.yaml#
$schema: http://devicetree.org/meta-schemas/core.yaml#

title: Fortinet FortiSOC3 true random number generator

maintainers:
  - Radeon24 <Radeon24@users.noreply.github.com>

description:
  Ring oscillator based random number generator of the miscellaneous block
  of the NP6Lite network processor of the Fortinet FortiSOC3. Its 64-byte
  register window lies inside the window of the network processor, whose
  driver requests the whole range; this one only maps it.

properties:
  compatible:
    const: fortinet,fsoc3-trng

  reg:
    maxItems: 1

required:
  - compatible
  - reg

additionalProperties: false

examples:
  - |
    rng@f500ff80 {
        compatible = "fortinet,fsoc3-trng";
        reg = <0xf500ff80 0x40>;
    };
```

## target/linux/fortisoc/files-6.18/Documentation/devicetree/bindings/rtc/fortinet,fsoc2-rtc.yaml
```yaml
# SPDX-License-Identifier: (GPL-2.0-only OR BSD-2-Clause)
%YAML 1.2
---
$id: http://devicetree.org/schemas/rtc/fortinet,fsoc2-rtc.yaml#
$schema: http://devicetree.org/meta-schemas/core.yaml#

title: Fortinet FortiSOC2 real-time clock

maintainers:
  - Radeon24 <Radeon24@users.noreply.github.com>

description:
  The battery-backed real-time clock of the Fortinet FortiSOC2, three
  registers of its system control unit (time, date, control) at offsets
  0x200, 0x204 and 0x210 of the unit. The node covers these registers
  only, from the time to the control register.

allOf:
  - $ref: rtc.yaml#

properties:
  compatible:
    const: fortinet,fsoc2-rtc

  reg:
    maxItems: 1

required:
  - compatible
  - reg

unevaluatedProperties: false

examples:
  - |
    rtc@e5100200 {
        compatible = "fortinet,fsoc2-rtc";
        reg = <0xe5100200 0x14>;
    };
```

## target/linux/fortisoc/files-6.18/Documentation/devicetree/bindings/rtc/fortinet,fsoc3-rtc.yaml
```yaml
# SPDX-License-Identifier: (GPL-2.0-only OR BSD-2-Clause)
%YAML 1.2
---
$id: http://devicetree.org/schemas/rtc/fortinet,fsoc3-rtc.yaml#
$schema: http://devicetree.org/meta-schemas/core.yaml#

title: Fortinet FortiSOC3 real-time clock

maintainers:
  - Radeon24 <Radeon24@users.noreply.github.com>

description:
  The battery-backed internal real-time clock of the Fortinet FortiSOC3.
  Its registers are bytes 4 bytes apart; the time and the date are BCD
  registers from offset 0x4c (seconds) to offset 0x64 (year, two digits),
  with a status register at offset 0x08 whose bit 1 is set while the
  counters are updated. No interrupt is known.

allOf:
  - $ref: rtc.yaml#

properties:
  compatible:
    const: fortinet,fsoc3-rtc

  reg:
    maxItems: 1

required:
  - compatible
  - reg

unevaluatedProperties: false

examples:
  - |
    rtc@fc700000 {
        compatible = "fortinet,fsoc3-rtc";
        reg = <0xfc700000 0x100>;
    };
```

## target/linux/fortisoc/files-6.18/Documentation/devicetree/bindings/soc/fortinet/fortinet,fsoc3-acp.yaml
```yaml
# SPDX-License-Identifier: (GPL-2.0-only OR BSD-2-Clause)
%YAML 1.2
---
$id: http://devicetree.org/schemas/soc/fortinet/fortinet,fsoc3-acp.yaml#
$schema: http://devicetree.org/meta-schemas/core.yaml#

title: Fortinet FortiSOC3 accelerator coherency port profiles

maintainers:
  - Radeon24 <Radeon24@users.noreply.github.com>

description:
  Block of eleven profiles, 0x20 bytes apart, in front of the accelerator
  coherency port (ACP) of the Cortex-A9 MPCore of the Fortinet FortiSOC3.
  Each profile holds an address range and attributes for the masters that
  reach the memory through the ACP, such as the NP6Lite network processor.
  The boot loader leaves most of them unset; the operating system programs
  them early, before the masters that rely on the ACP (marked dma-coherent)
  are used. The meaning of the fields is not publicly documented.

properties:
  compatible:
    const: fortinet,fsoc3-acp

  reg:
    maxItems: 1

required:
  - compatible
  - reg

additionalProperties: false

examples:
  - |
    acp@fb400000 {
        compatible = "fortinet,fsoc3-acp";
        reg = <0xfb400000 0x1000>;
    };
```

## target/linux/fortisoc/files-6.18/Documentation/devicetree/bindings/soc/fortinet/fortinet,fsoc3-sysmgr.yaml
```yaml
# SPDX-License-Identifier: (GPL-2.0-only OR BSD-2-Clause)
%YAML 1.2
---
$id: http://devicetree.org/schemas/soc/fortinet/fortinet,fsoc3-sysmgr.yaml#
$schema: http://devicetree.org/meta-schemas/core.yaml#

title: Fortinet FortiSOC3 system manager

maintainers:
  - Radeon24 <Radeon24@users.noreply.github.com>

description:
  System control registers of the Fortinet FortiSOC3. Among them, the
  restart request (bit 1 of the register at offset 0x68, see
  fortinet,fsoc3-reboot), the release of the secondary cores (bits 17 to
  19 of the register at offset 0x74) and their entry points (registers at
  offsets 0xf4 to 0xfc), used by the "fortinet,fsoc3-smp" enable-method.

properties:
  compatible:
    items:
      - const: fortinet,fsoc3-sysmgr
      - const: syscon

  reg:
    maxItems: 1

required:
  - compatible
  - reg

additionalProperties: false

examples:
  - |
    system-controller@fc000000 {
        compatible = "fortinet,fsoc3-sysmgr", "syscon";
        reg = <0xfc000000 0x1000>;
    };
```

## target/linux/fortisoc/files-6.18/Documentation/devicetree/bindings/spi/fortinet,fsoc2-ssp.yaml
```yaml
# SPDX-License-Identifier: (GPL-2.0-only OR BSD-2-Clause)
%YAML 1.2
---
$id: http://devicetree.org/schemas/spi/fortinet,fsoc2-ssp.yaml#
$schema: http://devicetree.org/meta-schemas/core.yaml#

title: Fortinet FortiSOC2 boot flash controller

maintainers:
  - Radeon24 <Radeon24@users.noreply.github.com>

description: |
  The Fortinet FortiSOC2 reaches the SPI NOR flash that holds its boot
  loader and factory data through the first of its Faraday FTSSP010
  synchronous serial ports, set up by the boot loader. The chip select of
  the flash is not one of the port: it is a line of a GPIO block, driven
  through the data set and data clear registers of that block.

  This description is for read accesses to that flash only: the node
  covers the registers of the port up to its data register, and the data
  set and data clear registers of the GPIO block, 8 bytes, nothing else of
  that block.

  "fortinet,fsoc2-ssp-bus" is another FTSSP010 port carrying regular
  SPI messages (the switches of the FortiGate 90D). Its chip select is
  another line of the same GPIO block: the driver refuses a port whose
  registers or chip select line are those of a flash port. Its optional
  third register is the pad control register of the system control unit
  (0xe5100328), whose bit 31 the driver sets before driving the line.

allOf:
  - $ref: spi-controller.yaml#

properties:
  compatible:
    enum:
      - fortinet,fsoc2-ssp
      - fortinet,fsoc2-ssp-bus

  reg:
    minItems: 2
    items:
      - description: FTSSP010 registers, up to the data register
      - description: Data set and data clear registers of the GPIO block
          that drives the chip select
      - description: Pad control register of the system control unit
          (fortinet,fsoc2-ssp-bus only)

  reg-names:
    minItems: 2
    items:
      - const: ssp
      - const: cs
      - const: pad

  fortinet,cs-line:
    $ref: /schemas/types.yaml#/definitions/uint32
    maximum: 31
    description: Line of the GPIO block wired to the chip select (active low).

required:
  - compatible
  - reg
  - reg-names
  - fortinet,cs-line

unevaluatedProperties: false

examples:
  - |
    spi@e4500000 {
        compatible = "fortinet,fsoc2-ssp";
        reg = <0xe4500000 0x1c>, <0xe4c00010 0x8>;
        reg-names = "ssp", "cs";
        fortinet,cs-line = <15>;
        #address-cells = <1>;
        #size-cells = <0>;

        flash@0 {
            compatible = "jedec,spi-nor";
            reg = <0>;
        };
    };
```

## target/linux/fortisoc/files-6.18/Documentation/devicetree/bindings/usb/fortinet,fsoc3-xhci.yaml
```yaml
# SPDX-License-Identifier: (GPL-2.0-only OR BSD-2-Clause)
%YAML 1.2
---
$id: http://devicetree.org/schemas/usb/fortinet,fsoc3-xhci.yaml#
$schema: http://devicetree.org/meta-schemas/core.yaml#

title: Fortinet FortiSOC3 xHCI controller

maintainers:
  - Radeon24 <Radeon24@users.noreply.github.com>

description: |
  The USB 3.0 host controller of the Fortinet FortiSOC3 (FortiGate 60E,
  100E): an R-Car Gen2 compatible xHCI, which runs a firmware of the R-Car
  format downloaded by the driver (xhci-rcar), then takes the Gen2
  settings.

  The port power switch can hang on a line of the GPIO block of the NP6Lite
  network processor (fortinet,fsoc3-gpio): that block is then given as a
  second register range, and the line in fortinet,vbus-line. The driver
  drives the line high once the firmware is downloaded, writing only its
  bit to the write-1-to-set registers of the block; the line must be
  listed in the gpio-reserved-ranges of the GPIO block.

allOf:
  - $ref: usb-xhci.yaml

properties:
  compatible:
    const: fortinet,fsoc3-xhci

  reg:
    minItems: 1
    items:
      - description: xHCI registers
      - description: GPIO block of the network processor (port power line)

  interrupts:
    maxItems: 1

  firmware-name:
    maxItems: 1
    description:
      File name of the controller firmware, R-Car format (for example a
      public R-Car USB 3.0 firmware of linux-firmware).

  dma-coherent: true

  fortinet,vbus-line:
    $ref: /schemas/types.yaml#/definitions/uint32
    maximum: 31
    description:
      Line of the GPIO block (second register range) that powers the port,
      driven high after the firmware download. Requires the second register
      range.

  fortinet,skip-fresh-ep-reset:
    type: boolean
    description:
      Do not send the Stop Endpoint and Configure Endpoint pair that clears
      the host side toggle of a bulk or interrupt endpoint whose transfer
      ring was never used since the endpoint was configured (its toggle is
      still 0). The first enumeration can fail on that pair with the
      public R-Car "v2" firmware.

  fortinet,trust-internal-ep-state:
    type: boolean
    description:
      Check the output context of each endpoint added by a successful
      Configure Endpoint against the input context sent then (state not
      disabled, same type and max packet, dequeue pointer inside its ring),
      and on a difference keep the endpoint running, build its soft toggle
      reset from the saved input context, and never skip Reset Device on an
      addressed slot read disabled. With the public R-Car "v2" firmware the
      controller sometimes writes an output context with the content of the
      context it wrote just before.

required:
  - compatible
  - reg
  - interrupts

unevaluatedProperties: false

examples:
  - |
    #include <dt-bindings/interrupt-controller/arm-gic.h>

    usb@f3008000 {
        compatible = "fortinet,fsoc3-xhci";
        reg = <0xf3008000 0x8000>,
              <0xf500fc00 0x80>;
        interrupts = <GIC_SPI 44 IRQ_TYPE_LEVEL_HIGH>;
        firmware-name = "r8a779x_usb3_v2-98d922b9.dlmem";
        fortinet,vbus-line = <6>;
        fortinet,skip-fresh-ep-reset;
        fortinet,trust-internal-ep-state;
    };
```
